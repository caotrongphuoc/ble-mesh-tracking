## nodes/bmt_gateway/sdkconfig.defaults
```kconfig
# =========================================================
# BMT Gateway sdkconfig defaults (common, target-agnostic)
# Target-specific overrides: sdkconfig.defaults.esp32s3
# =========================================================

# ---- Bluetooth core (NimBLE host — required for BLE Mesh on ESP32-S3) ----
# ESP_BLE_MESH (esp_ble_mesh_* API used in code) sits on top of NimBLE host.
# NimBLE's own mesh impl is disabled to avoid IS_ENABLED macro clash.
CONFIG_BT_ENABLED=y
CONFIG_BT_BLUEDROID_ENABLED=n
CONFIG_BT_NIMBLE_ENABLED=y
CONFIG_BT_CONTROLLER_ENABLED=y
CONFIG_BT_NIMBLE_MESH=n
CONFIG_BT_NIMBLE_TASK_STACK_SIZE=8192

# ---- ESP BLE Mesh ----
CONFIG_BLE_MESH=y
CONFIG_BLE_MESH_PROVISIONER=y
CONFIG_BLE_MESH_NODE=y
CONFIG_BLE_MESH_PB_ADV=y
CONFIG_BLE_MESH_PB_GATT=y
CONFIG_BLE_MESH_GATT_PROXY_SERVER=y
CONFIG_BLE_MESH_FRIEND=y
CONFIG_BLE_MESH_CFG_CLI=y
CONFIG_BLE_MESH_HEALTH_CLI=y
# Relay handled by dedicated bmt_relay device — gateway focuses on MQTT
# CONFIG_BLE_MESH_RELAY is not set
CONFIG_BLE_MESH_TX_SEG_MSG_COUNT=10
CONFIG_BLE_MESH_RX_SEG_MSG_COUNT=10
CONFIG_BLE_MESH_MAX_PROV_NODES=10
CONFIG_BLE_MESH_PBA_SAME_TIME=2
CONFIG_BLE_MESH_PBG_SAME_TIME=2

# ---- Partition table: single app large (no OTA yet) ----
CONFIG_PARTITION_TABLE_SINGLE_APP_LARGE=y

# ---- FreeRTOS / log ----
CONFIG_FREERTOS_HZ=1000
CONFIG_LOG_DEFAULT_LEVEL_INFO=y

# ---- MQTT (already enabled by component, keep TLS off for plain broker) ----
CONFIG_MQTT_PROTOCOL_311=y
```

## nodes/bmt_gateway/sdkconfig.defaults.esp32s3
```kconfig
# Target
CONFIG_IDF_TARGET="esp32s3"

# Flash 16MB
CONFIG_ESPTOOLPY_FLASHSIZE_16MB=y
CONFIG_ESPTOOLPY_FLASHSIZE="16MB"
CONFIG_ESPTOOLPY_FLASHFREQ_80M=y

# Octal PSRAM 8MB (N16R8)
CONFIG_SPIRAM=y
CONFIG_SPIRAM_MODE_OCT=y
CONFIG_SPIRAM_SPEED_80M=y
CONFIG_SPIRAM_USE_MALLOC=y

# CPU
CONFIG_ESP_DEFAULT_CPU_FREQ_MHZ_240=y
```
